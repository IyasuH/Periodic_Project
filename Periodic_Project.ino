#include <LedControl.h>

// pins for first MAX
int DIN_0 = 12; // datain
int CS_0 = 11; // load or chip shift
int CLK_0 = 10; // clock
char Incoming[15]; // bluetooth commands get turned into character array for parsing 
int wait = 50; // delay
LedControl lc_0=LedControl(DIN_0, CLK_0, CS_0, 2);

//defination for elements
//hydrogen
byte hydrogen_0[] = {0x00,0x00,0x00,0x00,0x00,0x00,0x00,0x00};
byte hydrogen_1[] = {0x01,0x00,0x00,0x00,0x00,0x00,0x00,0x00};
//calcium
byte calcium_0[] = {0x00,0x00,0x00,0x00,0x00,0x00,0x00,0x00};
byte calcium_1[] = {0x00,0x20,0x00,0x00,0x00,0x00,0x00,0x00};
//yttrium
byte yttrium_0[] = {0x00,0x00,0x00,0x00,0x00,0x00,0x00,0x00};
byte yttrium_1[] = {0x00,0x00,0x00,0x00,0x01,0x00,0x00,0x00};
//titanium
byte titanium_0[] = {0x00,0x00,0x00,0x00,0x00,0x00,0x00,0x00};
byte titanium_1[] = {0x00,0x00,0x00,0x02,0x00,0x00,0x00,0x00};
//vanadium
byte vanadium_0[] = {0x00,0x00,0x00,0x00,0x00,0x00,0x00,0x00};
byte vanadium_1[] = {0x00,0x00,0x00,0x04,0x00,0x00,0x00,0x00};
//chromium
byte chromium_0[] = {0x00,0x00,0x00,0x00,0x00,0x00,0x00,0x00};
byte chromium_1[] = {0x00,0x00,0x00,0x08,0x00,0x00,0x00,0x00};
//technetium
byte technetium_0[] = {0x00,0x00,0x00,0x00,0x00,0x00,0x00,0x00};
byte technetium_1[] = {0x00,0x00,0x00,0x00,0x10,0x00,0x00,0x00};
//lithium
byte lithium_0[] = {0x00,0x00,0x00,0x00,0x00,0x00,0x00,0x00};
byte lithium_1[] = {0x02,0x00,0x00,0x00,0x00,0x00,0x00,0x00};
//beryllium
byte beryllium_0[] = {0x00,0x00,0x00,0x00,0x00,0x00,0x00,0x00};
byte beryllium_1[] = {0x00,0x00,0x80,0x00,0x00,0x00,0x00,0x00};
//boron
byte boron_0[] = {0x00,0x00,0x00,0x00,0x00,0x00,0x00,0x00};
byte boron_1[] = {0x00,0x01,0x00,0x00,0x00,0x00,0x00,0x00};
//carbon
byte carbon_0[] = {0x00,0x00,0x00,0x00,0x00,0x00,0x00,0x00};
byte carbon_1[] = {0x00,0x02,0x00,0x00,0x00,0x00,0x00,0x00};
//nitrogen
byte nitrogen_0[] = {0x00,0x00,0x00,0x00,0x00,0x00,0x00,0x00};
byte nitrogen_1[] = {0x00,0x04,0x00,0x00,0x00,0x00,0x00,0x00};
//oxygen
byte oxygen_0[] = {0x00,0x00,0x00,0x00,0x00,0x00,0x00,0x00};
byte oxygen_1[] = {0x00,0x08,0x00,0x00,0x00,0x00,0x00,0x00};
//fluorine
byte fluorine_0[] = {0x00,0x40,0x00,0x00,0x00,0x00,0x00,0x00};
byte fluorine_1[] = {0x00,0x00,0x00,0x00,0x00,0x00,0x00,0x00};
//neon
byte neon_0[] = {0x00,0x80,0x00,0x00,0x00,0x00,0x00,0x00};
byte neon_1[] = {0x00,0x00,0x00,0x00,0x00,0x00,0x00,0x00};
//manganese
byte manganese_0[] = {0x00,0x00,0x00,0x00,0x00,0x00,0x00,0x00};
byte manganese_1[] = {0x00,0x00,0x00,0x10,0x00,0x00,0x00,0x00};
//iron
byte iron_0[] = {0x00,0x00,0x00,0x00,0x00,0x00,0x00,0x00};
byte iron_1[] = {0x00,0x00,0x00,0x20,0x00,0x00,0x00,0x00};
//cobalt
byte cobalt_0[] = {0x00,0x00,0x00,0x00,0x00,0x00,0x00,0x00};
byte cobalt_1[] = {0x00,0x00,0x00,0x40,0x00,0x00,0x00,0x00};
//nickel
byte nickel_0[] = {0x00,0x00,0x00,0x00,0x00,0x00,0x00,0x00};
byte nickel_1[] = {0x00,0x00,0x00,0x80,0x00,0x00,0x00,0x00};
//copper
byte copper_0[] = {0x00,0x00,0x00,0x01,0x00,0x00,0x00,0x00};
byte copper_1[] = {0x00,0x00,0x00,0x00,0x00,0x00,0x00,0x00};
//sodium
byte sodium_0[] = {0x00,0x00,0x00,0x00,0x00,0x00,0x00,0x00};
byte sodium_1[] = {0x04,0x00,0x00,0x00,0x00,0x00,0x00,0x00};
//mangnesium
byte mangnesium_0[] = {0x00,0x00,0x00,0x00,0x00,0x00,0x00,0x00};
byte mangnesium_1[] = {0x00,0x10,0x00,0x00,0x00,0x00,0x00,0x00};
//alumiinum
byte alumiinum_0[] = {0x00,0x00,0x00,0x00,0x00,0x00,0x00,0x00};
byte alumiinum_1[] = {0x00,0x00,0x01,0x00,0x00,0x00,0x00,0x00};
//zinc
byte zinc_0[] = {0x00,0x00,0x00,0x02,0x00,0x00,0x00,0x00};
byte zinc_1[] = {0x00,0x00,0x00,0x00,0x00,0x00,0x00,0x00};


//Series
//alkali
byte alkali_0[] = {0x00,0x00,0x00,0x00,0x00,0x00,0x00,0x00};
byte alkali_1[] = {0x7e,0x00,0x00,0x00,0x00,0x00,0x00,0x00};
//alkalien_earth_metals
byte earth_met_0[] = {0x00,0x00,0x00,0x00,0x00,0x00,0x00,0x00};
byte earth_met_1[] = {0x80,0xf0,0x80,0x00,0x00,0x00,0x00,0x00};
//transition_metals
byte transition_0[] = {0x00,0x00,0x00,0x03,0x03,0x03,0x03,0x00};
byte transition_1[] = {0x00,0x00,0x00,0xff,0xff,0xfe,0xfe,0x00};
//halogens
byte halogens_0[] = {0x00,0x40,0x40,0x40,0x40,0x40,0x40,0x00};
byte halogens_1[] = {0x00,0x00,0x00,0x00,0x00,0x00,0x00,0x00};//check for F
//lanthanoid
byte lanthanoid_0[] = {0x7f,0x3f,0x00,0x00,0x00,0x00,0x00,0x00};
byte lanthanoid_1[] = {0x00,0x00,0x00,0x00,0x00,0x01,0x00,0x00};
//other_metals
byte other_meta_0[] = {0x00,0x00,0x00,0x04,0x0c,0x3c,0x3c,0x00};
byte other_meta_1[] = {0x00,0x00,0x01,0x00,0x00,0x00,0x00,0x00};
//metalloids
byte metalloids_0[] = {0x00,0x00,0x00,0x18,0x30,0x00,0x00,0x00};
byte metalloids_1[] = {0x00,0x01,0x02,0x00,0x00,0x00,0x00,0x00};
//other_nonmetals
byte other_non_0[] = {0x00,0x00,0x00,0x20,0x00,0x00,0x00,0x00};
byte other_non_1[] = {0x01,0x0e,0x0c,0x00,0x00,0x00,0x00,0x00};
//nobel_gases
byte nobel_0[] = {0x80,0x80,0x80,0x80,0x80,0x80,0x80,0x00};
byte nobel_1[] = {0x00,0x00,0x00,0x00,0x00,0x00,0x00,0x00};
//actinod
byte actinod_0[] = {0x00,0x00,0x3f,0x00,0x00,0x00,0x00,0xff};
byte actinod_1[] = {0x00,0x00,0x00,0x00,0x00,0x00,0x01,0x00};

//State
//Solid
byte solid_0[] = {0x7f,0x3f,0x3f,0x3f,0x7f,0x7d,0x00,0xff};
byte solid_1[] = {0xbe,0xf3,0x8f,0xff,0xff,0xff,0x01,0x80};
//Liquid
byte liquid_0[] = {0x00,0x00,0x00,0x40,0x00,0x02,0x00,0x00};
byte liquid_1[] = {0x40,0x00,0x00,0x00,0x00,0x00,0x00,0x00};
//Gas
byte gas_0[] = {0x80,0xc0,0xc0,0x80,0x80,0x80,0x00,0x00};
byte gas_1[] = {0x01,0x0c,0x00,0x00,0x00,0x00,0x00,0x00};
//Unknown
byte unknown_0[] = {0x00,0x00,0x00,0x00,0x00,0x00,0xff,0x00};
byte unknown_1[] = {0x00,0x00,0x00,0x00,0x00,0x00,0xfe,0x00};

//all
byte all_0[] = {0xff,0xff,0xff,0xff,0xff,0xff,0xff,0xff};
byte all_1[] = {0xff,0xff,0xff,0xff,0xff,0xff,0xff,0xff};

//to clear the display and make it ready for the next display
void clearME()
{
  lc_0.clearDisplay(0);
  lc_0.clearDisplay(1); 
}

void setup() {
  lc_0.shutdown(0, false); // activating the first matrix
  lc_0.shutdown(1, false); // activating the second matrix
  lc_0.setIntensity(0, 5); // seting the brightness of the first matrix
  lc_0.setIntensity(1, 5); // seting the brightness of the second matrix
  lc_0.clearDisplay(0); // clearing display for the first matrix
  lc_0.clearDisplay(1); // clearing display for second matrix
  Serial.begin(9600);
}

void loop() {
  String state = "";//to store the command
  
  if (Serial.available() > 0)
  {
    state = Serial.readString();
    Serial.println("Command: " + String(Incoming));
    state.toCharArray(Incoming, 15);
    checkCommands(Incoming);
  }
}

//when command is recieved this function is called.
//The function compares its known commands to the one recieved. If there is a match
void checkCommands(char inStr[]){
  Serial.print("Check commands: ");
  Serial.println(inStr);
  //Series
  if(!strcmp(inStr, "Alkali")){clearME();printByte(alkali_0);delay(wait);printByte_1(alkali_1);delay(wait);}
  if(!strcmp(inStr, "AlkaliEarth")){clearME();printByte(earth_met_0);delay(wait);printByte_1(earth_met_1);delay(wait);}
  if(!strcmp(inStr, "Transition")){clearME();printByte(transition_0);delay(wait);printByte_1(transition_1);delay(wait);}
  if(!strcmp(inStr, "Halogens")){clearME();printByte(halogens_0);delay(wait);printByte_1(halogens_1);delay(wait);}
  if(!strcmp(inStr, "Lanthanoid")){clearME();printByte(lanthanoid_0);delay(wait);printByte_1(lanthanoid_1);delay(wait);}
  if(!strcmp(inStr, "OtherMetals")){clearME();printByte(other_meta_0);delay(wait);printByte_1(other_meta_1);delay(wait);}
  if(!strcmp(inStr, "Metalloids")){clearME();printByte(metalloids_0);delay(wait);printByte_1(metalloids_1);delay(wait);}
  if(!strcmp(inStr, "OtherNon")){clearME();printByte(other_non_0);delay(wait);printByte_1(other_non_1);delay(wait);}
  if(!strcmp(inStr, "NobleGas")){clearME();printByte(nobel_0);delay(wait);printByte_1(nobel_1);delay(wait);}
  if(!strcmp(inStr, "Actinod")){clearME();printByte(actinod_0);delay(wait);printByte_1(actinod_1);delay(wait);}
  //State
  if(!strcmp(inStr, "All")){clearME();printByte(all_0);delay(wait);printByte_1(all_1);delay(wait);}
  if(!strcmp(inStr, "Solid")){clearME();printByte(solid_0);delay(wait);printByte_1(solid_1);delay(wait);}
  if(!strcmp(inStr, "Liquid")){clearME();printByte(liquid_0);delay(wait);printByte_1(liquid_1);delay(wait);}
  if(!strcmp(inStr, "Gas")){clearME();printByte(gas_0);delay(wait);printByte_1(gas_1);delay(wait);}
  if(!strcmp(inStr, "Unknown")){clearME();printByte(unknown_0);delay(wait);printByte_1(unknown_1);delay(wait);}
  //Elements
  if(!strcmp(inStr, "Hydrogen")){clearME();printByte(hydrogen_0);delay(wait);printByte_1(hydrogen_1);delay(wait);}
  if(!strcmp(inStr, "Calcium")){clearME();printByte(calcium_0);delay(wait);printByte_1(calcium_1);delay(wait);}
  if(!strcmp(inStr, "Yttrium")){clearME();printByte(yttrium_0);delay(wait);printByte_1(yttrium_1);delay(wait);}
  if(!strcmp(inStr, "Titanium")){clearME();printByte(titanium_0);delay(wait);printByte_1(titanium_1);delay(wait);}
  if(!strcmp(inStr, "Vanadium")){clearME();printByte(vanadium_0);delay(wait);printByte_1(vanadium_1);delay(wait);}
  if(!strcmp(inStr, "Chromium")){clearME();printByte(chromium_0);delay(wait);printByte_1(chromium_1);delay(wait);}
  if(!strcmp(inStr, "Technetium")){clearME();printByte(technetium_0);delay(wait);printByte_1(technetium_1);delay(wait);}
  if(!strcmp(inStr, "Lithium")){clearME();printByte(lithium_0);delay(wait);printByte_1(lithium_1);delay(wait);}
  if(!strcmp(inStr, "Beryllium")){clearME();printByte(beryllium_0);delay(wait);printByte_1(beryllium_1);delay(wait);}
  if(!strcmp(inStr, "Boron")){clearME();printByte(boron_0);delay(wait);printByte_1(boron_1);delay(wait);}
  if(!strcmp(inStr, "Carbon")){clearME();printByte(carbon_0);delay(wait);printByte_1(carbon_1);delay(wait);}
  if(!strcmp(inStr, "Nitrogen")){clearME();printByte(nitrogen_0);delay(wait);printByte_1(nitrogen_1);delay(wait);}
  if(!strcmp(inStr, "Oxygen")){clearME();printByte(oxygen_0);delay(wait);printByte_1(oxygen_1);delay(wait);}
  if(!strcmp(inStr, "Fluorine")){clearME();printByte(fluorine_0);delay(wait);printByte_1(fluorine_1);delay(wait);}
  if(!strcmp(inStr, "Neon")){clearME();printByte(neon_0);delay(wait);printByte_1(neon_1);delay(wait);}
  if(!strcmp(inStr, "Manganese")){clearME();printByte(manganese_0);delay(wait);printByte_1(manganese_1);delay(wait);}
  if(!strcmp(inStr, "Iron")){clearME();printByte(iron_0);delay(wait);printByte_1(iron_1);delay(wait);}
  if(!strcmp(inStr, "Cobalt")){clearME();printByte(cobalt_0);delay(wait);printByte_1(cobalt_1);delay(wait);}
  if(!strcmp(inStr, "Nickel")){clearME();printByte(nickel_0);delay(wait);printByte_1(nickel_1);delay(wait);}
  if(!strcmp(inStr, "Coper")){clearME();printByte(copper_0);delay(wait);printByte_1(copper_1);delay(wait);}
  if(!strcmp(inStr, "Sodium")){clearME();printByte(sodium_0);delay(wait);printByte_1(sodium_1);delay(wait);}
  if(!strcmp(inStr, "Magnesium")){clearME();printByte(mangnesium_0);delay(wait);printByte_1(mangnesium_1);delay(wait);}
  if(!strcmp(inStr, "Aluminum")){clearME();printByte(alumiinum_0);delay(wait);printByte_1(alumiinum_1);delay(wait);}
  if(!strcmp(inStr, "Zinc")){clearME();printByte(zinc_0);delay(wait);printByte_1(zinc_1);delay(wait);}
}

//half periodic
void printByte(byte character[]){
  int i;
  for (i=0; i<8; i++){lc_0.setRow(0,i,character[i]);}
}
//half periodic
void printByte_1(byte character[]){
  int i;
  for (i=0; i<8; i++){lc_0.setRow(1,i,character[i]);}
}
